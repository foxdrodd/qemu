## hw/sh4/Kconfig
```kconfig
config R2D
    bool
    default y
    depends on SH4
    imply PCI_DEVICES
    imply TEST_DEVICES
    imply RTL8139_PCI
    select I82378 if TEST_DEVICES
    select IDE_MMIO
    select PFLASH_CFI02
    select PCI
    select SM501
    select SH7750
    select SH_PCI

config J2
    bool
    default y
    depends on SH4
    select XILINX          # Xilinx UARTLite (ttyUL0 console)
    select UNIMP
    select DEVICE_TREE     # load_device_tree() for the mainline DT kernel (-dtb)
    select SSI             # jcore SPI master's SSI bus
    select SSI_SD          # SD card over SPI (mmc_spi)

config SH7750
    bool
    select SH_INTC
    select SH_SCI
    select SH_TIMER
```
